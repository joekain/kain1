## boards/shields/kain1/Kconfig.defconfig
```kconfig
if SHIELD_KAIN1_LEFT

config ZMK_KEYBOARD_NAME
       default "Kain1"

config ZMK_SPLIT_ROLE_CENTRAL
       default y

endif

if SHIELD_KAIN1_LEFT || SHIELD_KAIN1_RIGHT

config ZMK_SPLIT
       default y

endif
```

## boards/shields/kain1/Kconfig.shield
```kconfig
# Copyright (c) 2024 Joseph Kain
# SPDX-License-Identifier: MIT

config SHIELD_KAIN1_LEFT
    def_bool $(shields_list_contains,kain1_left)

config SHIELD_KAIN1_RIGHT
    def_bool $(shields_list_contains,kain1_right)
```
